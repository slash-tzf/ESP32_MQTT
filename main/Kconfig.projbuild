## main/Kconfig.projbuild
```kconfig
menu "4G Modem Example Config"

    config EXAMPLE_ENABLE_WEB_ROUTER
        bool "Open web configuration"
        default y
        help
            Open the web router, you can configure the system parameters

    config EXAMPLE_WEB_MOUNT_POINT  
        string "Website mount point in VFS"
        default "/spiffs"
        depends on EXAMPLE_ENABLE_WEB_ROUTER
        help
            Specify the mount point in VFS.

    config EXAMPLE_ENTER_PPP_DURING_INIT
        bool "Auto enter ppp mode"
        default y
        help
            If not enable, just stay in command mode, user can call modem_board_ppp_start to enter network mode later

    config EXAMPLE_AUTO_UPDATE_DNS
        bool "Auto update Wi-Fi soft ap DNS address"
        default n
        help
            If true using dns address got from ppp

    config EXAMPLE_PING_NETWORK
        bool "Ping network to check the state"
        default n

    config EXAMPLE_PING_MANUAL
        bool "Ping manual address"
        default n

    config EXAMPLE_PING_MANUAL_ADDR
        string "Manual address"
        default "8.8.8.8"
        depends on EXAMPLE_PING_MANUAL

    config EXAMPLE_PING_TIMEOUT
        int "ping timeout value (ms)"
        default 2000
        depends on EXAMPLE_PING_NETWORK

    config DUMP_SYSTEM_STATUS
        bool "Dump system task status"
        default n
        help
            Dump system task status, stack left, cpu load, etc.

    config EXAMPLE_LED_RED_SYSTEM_GPIO
        int "System status led (red) gpio, set 0 if not use"
        default 0
    config EXAMPLE_LED_BLUE_WIFI_GPIO
        int "Wi-Fi status led (blue) gpio, set 0 if not use"
        default 0
    config EXAMPLE_LED_GREEN_4GMODEM_GPIO
        int "Modem status led (green) gpio, set 0 if not use"
        default 0
    
    menu "GNSS Configuration"
        config GNSS_UART_NUM
            int "UART port number"
            default 1
        config GNSS_UART_RX
            int "UART RX GPIO number"
            default 17
        config GNSS_UART_TX
            int "UART TX GPIO number"
            default 18
    endmenu

    menu "Sensors Configuration"
        config DHT11_GPIO_PIN
            int "DHT11 GPIO number"
            default 16
        config BH1750_I2C_ADDRESS
            hex "BH1750 I2C address"
            default 0x23
        config BH1750_I2C_SDA_PIN
            int "BH1750 I2C SDA pin"
            default 7
        config BH1750_I2C_SCL_PIN
            int "BH1750 I2C SCL pin"
            default 8
        config BH1750_I2C_FREQ_HZ
            int "BH1750 I2C frequency"
            default 100000

        config GY26_ENABLE
            bool "Enable GY-26 compass (I2C)"
            default n

        config GY26_I2C_PORT
            int "GY-26 I2C port number (0 or 1)"
            default 1
            depends on GY26_ENABLE

        config GY26_I2C_SDA_PIN
            int "GY-26 I2C SDA pin"
            default 9
            depends on GY26_ENABLE

        config GY26_I2C_SCL_PIN
            int "GY-26 I2C SCL pin"
            default 10
            depends on GY26_ENABLE

        config GY26_I2C_FREQ_HZ
            int "GY-26 I2C frequency"
            default 100000
            depends on GY26_ENABLE

        config GY26_I2C_ADDRESS_7BIT
            hex "GY-26 I2C 7-bit address"
            default 0x70
            depends on GY26_ENABLE
            help
                GY-26 vendor docs use 0xE0/0xE1 (8-bit). The equivalent 7-bit address is 0x70.

        config GY26_MEASURE_DELAY_HEADING_MS
            int "GY-26 heading measure delay (ms)"
            default 60
            depends on GY26_ENABLE

        config GY26_MEASURE_DELAY_TEMP_MS
            int "GY-26 temperature measure delay (ms)"
            default 30
            depends on GY26_ENABLE
    endmenu

    menu "MQTT Configuration"
        config MQTT_BROKER_URI
            string "MQTT broker URI"
            default "mqtts://116.62.62.70"
            help
                MQTT服务器地址，格式为mqtt://hostname:port
        config MQTT_BROKER_USERNAME
            string "MQTT broker username"
            default ""
            help
                MQTT服务器用户名，如不需要可留空
        config MQTT_BROKER_PASSWORD
            string "MQTT broker password"
            default ""
            help
                MQTT服务器密码，如不需要可留空
        config MQTT_OTA_TOPIC
            string "MQTT OTA topic"
            default "sys/ota"
            help
                OTA消息的MQTT主题
    endmenu
endmenu
```
